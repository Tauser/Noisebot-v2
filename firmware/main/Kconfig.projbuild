## firmware/main/Kconfig.projbuild
```kconfig
menu "NoiseBot 2"

    config NB_WAKE_BENCH_HARNESS
        bool "Harness de bancada para wake_service (RMS heuristico)"
        default n
        help
            Uso EXCLUSIVO de bancada para S4.2. Emula wake/VAD por RMS do
            microfone dentro da task temporaria de audio_bringup, sem
            WakeNet/ESP-SR reais. Serve para exercitar a sessao de voz e a
            publicacao no event_bus antes da integracao final. Nunca usar
            como fallback silencioso de producao (VOICE.md V-5).

    config NB_WAKE_BENCH_WAKE_RMS
        int "Limiar RMS para disparar wake (bench)"
        depends on NB_WAKE_BENCH_HARNESS
        default 1800
        range 1 32767
        help
            RMS minimo do chunk de microfone para o harness de bancada
            chamar wake_service_shell_trigger_wake().

    config NB_WAKE_BENCH_VAD_RMS
        int "Limiar RMS para speech/VAD (bench)"
        depends on NB_WAKE_BENCH_HARNESS
        default 700
        range 1 32767
        help
            RMS minimo do chunk de microfone para o harness de bancada
            tratar o frame como fala durante a sessao.

    config NB_WAKE_BENCH_COOLDOWN_MS
        int "Cooldown entre wakes (bench)"
        depends on NB_WAKE_BENCH_HARNESS
        default 3000
        range 100 60000
        help
            Janela minima entre duas tentativas de wake no harness de
            bancada, para evitar retrigger em cascata por ruido.

    config NBP2_SERVER_HOST
        string "Host (IP ou nome) do server NBP/2 (a mente)"
        default ""
        help
            Endereço do server Python na LAN local. Vazio = mind_link fica
            tentando reconectar indefinidamente sem nunca conseguir (comportamento
            seguro por padrão: robô continua autônomo offline — P1).

    config NBP2_SERVER_PORT
        int "Porta TCP do server NBP/2"
        default 9100
        help
            Deve bater com protocol.port em protocol/nbp2.yaml.

endmenu
```

## firmware/sdkconfig.defaults
```kconfig
# NoiseBot 2 — defaults (Waveshare ESP32-S3-DEV-KIT N32R16V:
# módulo WROOM-2, 32MB flash octal OPI + 16MB PSRAM octal, VDD_SPI 1.8V)

CONFIG_IDF_TARGET="esp32s3"

# Flash 32MB octal (OPI) — confirmar no S0.1 com a unidade em mãos
CONFIG_ESPTOOLPY_FLASHSIZE_32MB=y
CONFIG_ESPTOOLPY_OCT_FLASH=y
CONFIG_PARTITION_TABLE_CUSTOM=y
CONFIG_PARTITION_TABLE_CUSTOM_FILENAME="partitions.csv"

# PSRAM 16MB octal
CONFIG_SPIRAM=y
CONFIG_SPIRAM_MODE_OCT=y
CONFIG_SPIRAM_SPEED_80M=y
CONFIG_SPIRAM_MALLOC_ALWAYSINTERNAL=4096
CONFIG_SPIRAM_MALLOC_RESERVE_INTERNAL=65536

# FreeRTOS
CONFIG_FREERTOS_HZ=1000

# Logs (dev; produção usa nível INFO e CONFIG_NB2_DEV_BUILD desligado — S1.3)
CONFIG_LOG_DEFAULT_LEVEL_INFO=y

# Coredump em flash (S1.3)
CONFIG_ESP_COREDUMP_ENABLE_TO_FLASH=y
CONFIG_ESP_COREDUMP_DATA_FORMAT_ELF=y

# Watchdog (S1.5 endurece)
CONFIG_ESP_TASK_WDT_EN=y
CONFIG_ESP_TASK_WDT_TIMEOUT_S=10

# Segurança — habilitados de verdade em S1.8 (exigem gestão de chaves; ver SECURITY.md):
# CONFIG_SECURE_BOOT=y
# CONFIG_SECURE_FLASH_ENC_ENABLED=y
```
